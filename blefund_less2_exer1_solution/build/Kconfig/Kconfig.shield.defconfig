## blefund_less2_exer1_solution/build/Kconfig/Kconfig.shield.defconfig
```kconfig
osource "c:/users/sienp/bt-fund/lesson2/blefund_less2_exer1_solution/boards/shields/*/Kconfig.defconfig"
osource "C:/ncs/v2.5.0/nrf/boards/shields/*/Kconfig.defconfig"
```

## code/driver_detector/build/Kconfig/Kconfig.shield
```kconfig
osource "c:/users/sienp/documents/school/iiw4/iot_systems/git/driver_detector/code/driver_detector/boards/shields/*/Kconfig.shield"
osource "C:/ncs/v2.5.0/nrf/boards/shields/*/Kconfig.shield"
```

## code/driver_detector/build/Kconfig/Kconfig.shield.defconfig
```kconfig
osource "c:/users/sienp/documents/school/iiw4/iot_systems/code/driver_detector/boards/shields/*/Kconfig.defconfig"
osource "C:/Users/sienp/Documents/school/IIW4/IoT_systems/code/driver_detector/./boards/shields/*/Kconfig.defconfig"
osource "C:/ncs/v2.5.0/nrf/boards/shields/*/Kconfig.defconfig"
```
